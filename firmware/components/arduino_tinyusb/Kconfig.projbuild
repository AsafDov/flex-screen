## firmware/components/arduino_tinyusb/Kconfig.projbuild
```kconfig
# Arduino's TinyUSB settings, for builds that recompile ESP-IDF (env:deck-mem).
# Arduino's own arduino_tinyusb component lives in esp32-arduino-lib-builder and isn't part
# of a custom_sdkconfig rebuild, so without these the USB keyboard, media keys and serial
# link compile out. The values are the stock ones the prebuilt library in lib/ was built
# with; keep them identical or the library and the headers disagree.
menu "Arduino TinyUSB (prebuilt)"
    depends on SOC_USB_OTG_SUPPORTED

    config TINYUSB_ENABLED
        bool "Enable TinyUSB driver"
        default y

    config TINYUSB_CDC_ENABLED
        bool "CDC"
        depends on TINYUSB_ENABLED
        default y
    config TINYUSB_DESC_CDC_STRING
        string "CDC device string"
        depends on TINYUSB_CDC_ENABLED
        default "Espressif CDC Device"
    config TINYUSB_CDC_RX_BUFSIZE
        int "CDC FIFO size of RX"
        depends on TINYUSB_CDC_ENABLED
        default 64
    config TINYUSB_CDC_TX_BUFSIZE
        int "CDC FIFO size of TX"
        depends on TINYUSB_CDC_ENABLED
        default 64
    config TINYUSB_CDC_MAX_PORTS
        int "Maximum CDC ports"
        depends on TINYUSB_CDC_ENABLED
        default 2

    config TINYUSB_MSC_ENABLED
        bool "MSC"
        depends on TINYUSB_ENABLED
        default y
    config TINYUSB_DESC_MSC_STRING
        string "MSC device string"
        depends on TINYUSB_MSC_ENABLED
        default "Espressif MSC Device"
    config TINYUSB_MSC_BUFSIZE
        int "MSC buffer size"
        depends on TINYUSB_MSC_ENABLED
        default 4096

    config TINYUSB_HID_ENABLED
        bool "HID"
        depends on TINYUSB_ENABLED
        default y
    config TINYUSB_DESC_HID_STRING
        string "HID device string"
        depends on TINYUSB_HID_ENABLED
        default "Espressif HID Device"
    config TINYUSB_HID_BUFSIZE
        int "HID buffer size"
        depends on TINYUSB_HID_ENABLED
        default 64

    config TINYUSB_MIDI_ENABLED
        bool "MIDI"
        depends on TINYUSB_ENABLED
        default y
    config TINYUSB_DESC_MIDI_STRING
        string "MIDI device string"
        depends on TINYUSB_MIDI_ENABLED
        default "Espressif MIDI Device"
    config TINYUSB_MIDI_RX_BUFSIZE
        int "MIDI FIFO size of RX"
        depends on TINYUSB_MIDI_ENABLED
        default 64
    config TINYUSB_MIDI_TX_BUFSIZE
        int "MIDI FIFO size of TX"
        depends on TINYUSB_MIDI_ENABLED
        default 64

    config TINYUSB_AUDIO_ENABLED
        bool "Audio"
        depends on TINYUSB_ENABLED
        default y
    config TINYUSB_DESC_AUDIO_STRING
        string "Audio device string"
        depends on TINYUSB_AUDIO_ENABLED
        default "Espressif AUDIO Device"

    config TINYUSB_VIDEO_ENABLED
        bool "Video"
        depends on TINYUSB_ENABLED
        default y
    config TINYUSB_DESC_VIDEO_STRING
        string "Video device string"
        depends on TINYUSB_VIDEO_ENABLED
        default "Espressif VIDEO Device"
    config TINYUSB_VIDEO_STREAMING_BUFSIZE
        int "Video streaming buffer size"
        depends on TINYUSB_VIDEO_ENABLED
        default 64
    config TINYUSB_VIDEO_STREAMING_IFS
        int "Video streaming interfaces"
        depends on TINYUSB_VIDEO_ENABLED
        default 1

    config TINYUSB_DFU_RT_ENABLED
        bool "DFU runtime"
        depends on TINYUSB_ENABLED
        default y
    config TINYUSB_DESC_DFU_RT_STRING
        string "DFU runtime device string"
        depends on TINYUSB_DFU_RT_ENABLED
        default "Espressif DFU_RT Device"

    config TINYUSB_DFU_ENABLED
        bool "DFU"
        depends on TINYUSB_ENABLED
        default y
    config TINYUSB_DESC_DFU_STRING
        string "DFU device string"
        depends on TINYUSB_DFU_ENABLED
        default "Espressif DFU Device"
    config TINYUSB_DFU_BUFSIZE
        int "DFU buffer size"
        depends on TINYUSB_DFU_ENABLED
        default 4096

    config TINYUSB_VENDOR_ENABLED
        bool "Vendor"
        depends on TINYUSB_ENABLED
        default y
    config TINYUSB_DESC_VENDOR_STRING
        string "Vendor device string"
        depends on TINYUSB_VENDOR_ENABLED
        default "Espressif VENDOR Device"
    config TINYUSB_VENDOR_RX_BUFSIZE
        int "Vendor FIFO size of RX"
        depends on TINYUSB_VENDOR_ENABLED
        default 64
    config TINYUSB_VENDOR_TX_BUFSIZE
        int "Vendor FIFO size of TX"
        depends on TINYUSB_VENDOR_ENABLED
        default 64

    config TINYUSB_NCM_ENABLED
        bool "NCM"
        depends on TINYUSB_ENABLED
        default y

    config TINYUSB_DEBUG_LEVEL
        int "TinyUSB debug level"
        depends on TINYUSB_ENABLED
        default 0
endmenu
```
